## conf/layer.conf
```bitbake
# We have a conf and classes directory, add to BBPATH
BBPATH .= ":${LAYERDIR}"

# We have recipes-* directories, add to BBFILES
BBFILES += "${LAYERDIR}/recipes-*/*/*.bb ${LAYERDIR}/recipes-*/*/*.bbappend"

BBFILE_COLLECTIONS += "imx6-secure-boot"
BBFILE_PATTERN_imx6-secure-boot = "^${LAYERDIR}/"
BBFILE_PRIORITY_imx6-secure-boot = "6"

# This should only be incremented on significant changes that will
# cause compatibility issues with other layers
LAYERVERSION_imx6-secure-boot = "1"

LAYERDEPENDS_imx6-secure-boot = "core freescale-layer"
```

## conf/machine/wandboard-secure-boot.conf
```bitbake
#@TYPE: Machine
#@NAME: Wandboard i.MX6 Wandboard Quad/Dual/Solo
#@SOC: i.MX6Q/DL
#@DESCRIPTION: Machine configuration for i.MX6 Wandboard Quad
#@MAINTAINER: Alfonso Tames <alfonso@tames.com>

MACHINEOVERRIDES =. "mx6:mx6dl:mx6q:"

include conf/machine/include/imx-base.inc
include conf/machine/include/tune-cortexa9.inc

UBOOT_MAKE_TARGET = ""
UBOOT_SUFFIX = "img"
UBOOT_BINARY = "u-boot-ivt.img"
SPL_BINARY = "SPL"
UBOOT_MACHINE = "wandboard_secure_boot_config"
PREFERRED_PROVIDER_u-boot = "u-boot-secureboot"
PREFERRED_PROVIDER_virtual/bootloader = "u-boot-secureboot"

PREFERRED_PROVIDER_virtual/kernel ?= "linux-fslc-ima"
KERNEL_DEVICETREE = " \
    imx6dl-wandboard-revb1.dtb \
    imx6dl-wandboard.dtb \
    imx6q-wandboard-revb1.dtb \
    imx6q-wandboard.dtb \
"

KERNEL_IMAGETYPE = "fitImage"
KERNEL_CLASSES += "kernel-fitimage uboot-embed-sign"

MACHINE_FEATURES += "bluetooth pci wifi touchscreen"

MACHINE_EXTRA_RRECOMMENDS += " \
  bcm4329-nvram-config \
  bcm4330-nvram-config \
"

SERIAL_CONSOLE = "115200 ttymxc0"

MACHINE_ESSENTIAL_EXTRA_RDEPENDS += " \
    kernel-image \
    kernel-devicetree \
    u-boot-secureboot \
"

WKS_FILES = "imx-uboot-ivt-spl.wks"

IMAGE_DEPENDS_wic_append = " virtual/bootloader"

IMAGE_FSTYPES = "wic.gz"

UBOOT_SIGN_ENABLE = "1"
UBOOT_SIGN_KEYDIR = "/home/esven/git/thesis/HABv4/cst-2.3.1/keys"
# keys name in keydir (eg. "dev.crt", "dev.key")
UBOOT_SIGN_KEYNAME = "dev"
UBOOT_MKIMAGE_DTCOPTS = "-I dts -O dtb -p 2000"

HAB_SIGN_CSFKEY = "/home/esven/git/thesis/HABv4/cst-2.3.1/crts/CSF1_1_sha256_4096_65537_v3_usr_crt.pem"
HAB_SIGN_IMGKEY = "/home/esven/git/thesis/HABv4/cst-2.3.1/crts/IMG1_1_sha256_4096_65537_v3_usr_crt.pem"
HAB_SIGN_SRKTABLE = "/home/esven/git/thesis/HABv4/cst-2.3.1/crts/SRK_1_2_3_4_table.bin"

INITRAMFS_IMAGE = "initramfs-evm-init-image"
UBOOT_RD_LOADADDRESS = "0x12C00000"
UBOOT_RD_ENTRYPOINT = "0x12C00000"

IMA_EVM_KEY_DIR = "/home/esven/openembedded/krogoth/poky/meta-intel-iot-security/meta-integrity/scripts/keys"
IMA_EVM_ROOTFS_IVERSION = "/dev/root"
IMA_EVM_ROOT_CA = "/home/esven/openembedded/krogoth/poky/meta-fsl-arm/recipes-kernel/linux/linux-fslc/certificate.pem"

INHERIT += " ima-evm-rootfs "
```
