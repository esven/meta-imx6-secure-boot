/*
 * Copyright 2016 Sven Ebenfeld
 *
 * The code contained herein is licensed under the GNU General Public
 * License. You may obtain a copy of the GNU General Public License
 * Version 2 or later at the following locations:
 *
 * http://www.opensource.org/licenses/gpl-license.html
 * http://www.gnu.org/copyleft/gpl.html
 */

/dts-v1/;

/ {
	model = "Keys";
	compatible = "wand,imx6dl-wandboard", "fsl,imx6dl";

	signature {
		key-dev {
			required = "conf";
			algo = "sha256,rsa4096";
			key-name-hint = "my_key";
		};
	};
};